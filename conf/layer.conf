## conf/layer.conf
```bitbake
BBPATH := "${BBPATH}:${LAYERDIR}" 
BBFILES := "${BBFILES} ${LAYERDIR}/recipes-*/*/*/*.bb ${LAYERDIR}/recipes-*/*/*/*.bbappend" 
BBFILE_COLLECTIONS += "bc"
BBFILE_PATTERN_bc := "^${LAYERDIR}/" 
BBFILE_PRIORITY_bc := "5"
LAYERSERIES_COMPAT_bc = "sumo"

LICENSE_FLAGS_WHITELIST="commercial_libav"

PREFERED_LINPHONE_SDK_RECIPE_VERSION ?= "latest"
PREFERRED_VERSION_linphone-sdk="${PREFERED_LINPHONE_SDK_RECIPE_VERSION}"
```
